## drivers/WiFi_driver_pack/Kconfig
```kconfig
comment "Aditional WiFi adapter drivers for NetHunter by @S133PY"

source "drivers/WiFi_driver_pack/rtl8188eus/Kconfig"

source "drivers/WiFi_driver_pack/rtl8188fu/Kconfig"

source "drivers/WiFi_driver_pack/rtl8812au/Kconfig"

source "drivers/WiFi_driver_pack/rtl8192eu/Kconfig"
```
